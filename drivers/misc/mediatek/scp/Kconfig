## drivers/misc/mediatek/scp/Kconfig
```kconfig
config MTK_TINYSYS_SCP_SUPPORT
	bool "Specify Interface Support SCP"
	default n
	help
	  SCP is a MediaTek in-house DSP which can receive
	  command from IPI interface.
	  Set Y to enable this feature.
	  If unsure,
	  Set N to stay with legancy feature.

config MTK_TINYSYS_SCP_LOGGER_SUPPORT
	bool "SCP Logger support"
	depends on MTK_TINYSYS_SCP_SUPPORT
	default y
	help
	  This is debug feature: SCP logger on/off option.
	  Set Y to enable this feature.
	  Set N to disable this feature.
	  If unsure, Set Y to have debug log.

config SENSOR_PARAM_TO_SCP
       bool "AP sensor param to scp support"
       default n
       help
         Support send sensor param from ap to scp
         Set Y to enable this feature.
         If unsure, Set N to disable this feature.
```

## drivers/misc/mediatek/sensors-1.0/situation/sar/Kconfig
```kconfig
config MTK_SAR_HUB
	bool "sarthub for MediaTek package"
	default n
	help
	  A sar is a device,
	  usually portable and electronic
	  or electromechanical,
	  that detect distance between the body and device .

config MTK_AP_SAR
	bool "AP SAR for MediaTek package"
	default n
	help
	  Say Y to use AP sar.
	  if N here to use HUB sar.

config TARGET_PROJECT_P11
	bool "P11 project"
	default n
	help
	  Say Y to build P11.
	  if N here to build P530.

config SAR_SX933X
	tristate "Semtch SAR SENSOR"
	depends on I2C
	default n
	help
	  Say Y to enable the SAR detection application,
	  if N here not to use this SAR sensor

config SAR_AW9610X
	tristate "Awinic AW9610X_Sar driver"
	depends on I2C
	help
	  Say Y here if you have Awinic AW9610X_Sar controller
	  chip in your system.
	  If unsure, say N.
	  To compile this driver as a module, choose M here: the
	  module will be called AW9610X_Sar key.

config SAR_AT96T375
	tristate "Abov SAR SENSOR"
	depends on I2C
	default n
	help
	  Say Y to enable the Abov at96t375 SAR sensor,
	  if N here not to use this SAR sensor
```
